## CMakeLists.txt
```
# Copyright (c) 2025 Dato Musical Instruments
# SPDX-License-Identifier: Apache-2.0

cmake_minimum_required(VERSION 3.20.0)

find_package(Zephyr REQUIRED HINTS $ENV{ZEPHYR_BASE})
project(duo_midi_tests LANGUAGES C CXX)

set(DUO_APP_SRC ${CMAKE_CURRENT_LIST_DIR}/../../app/src)

target_sources(app PRIVATE
  src/test_midi_parser.cpp
  src/test_ump_convert.cpp

  # Units under test, compiled straight out of the firmware.
  ${DUO_APP_SRC}/platform/midi_parser.cpp
  ${DUO_APP_SRC}/platform/ump_convert.cpp
)

target_include_directories(app PRIVATE
  ${DUO_APP_SRC}
  ${DUO_APP_SRC}/compat
)
```

## prj.conf
```kconfig
# Copyright (c) 2025 Dato Musical Instruments
# SPDX-License-Identifier: Apache-2.0

CONFIG_ZTEST=y

CONFIG_CPP=y
CONFIG_STD_CPP17=y
# Resolves to the host libstdc++ on native_sim and to GNU libstdc++ on the
# target; the firmware needs <cmath> and <cstring>, which the minimal C++
# library does not provide.
CONFIG_REQUIRES_FULL_LIBCPP=y
CONFIG_CPP_EXCEPTIONS=n
CONFIG_CPP_RTTI=n

# duo_compat.h reaches for the entropy source to implement random().
CONFIG_ENTROPY_GENERATOR=y
```

## src/test_midi_parser.cpp
```c
/*
 * Copyright (c) 2025 Dato Musical Instruments
 * SPDX-License-Identifier: Apache-2.0
 *
 * Tests for the MIDI 1.0 byte-stream parser that replaced the Arduino MIDI
 * Library. The DUO listens on one channel at a time, so channel filtering and
 * running status are as important as the message decoding itself.
 */

#include "platform/midi_parser.h"

#include <zephyr/ztest.h>

#include <cstring>

/* The parser reports through C function pointers, so the observations land here. */
static struct {
	int note_on_count;
	int note_off_count;
	int cc_count;
	int clock_count;
	int start_count;
	int cont_count;
	int stop_count;
	int sysex_count;

	uint8_t last_channel;
	uint8_t last_data1;
	uint8_t last_data2;

	unsigned sysex_len;
	uint8_t sysex[MidiParser::SYSEX_MAX];
} seen;

static void on_note_on(byte channel, byte note, byte velocity)
{
	seen.note_on_count++;
	seen.last_channel = channel;
	seen.last_data1 = note;
	seen.last_data2 = velocity;
}

static void on_note_off(byte channel, byte note, byte velocity)
{
	seen.note_off_count++;
	seen.last_channel = channel;
	seen.last_data1 = note;
	seen.last_data2 = velocity;
}

static void on_cc(byte channel, byte number, byte value)
{
	seen.cc_count++;
	seen.last_channel = channel;
	seen.last_data1 = number;
	seen.last_data2 = value;
}

static void on_clock(void)
{
	seen.clock_count++;
}

static void on_start(void)
{
	seen.start_count++;
}

static void on_continue(void)
{
	seen.cont_count++;
}

static void on_stop(void)
{
	seen.stop_count++;
}

static void on_sysex(byte *data, unsigned length)
{
	seen.sysex_count++;
	seen.sysex_len = length;
	memcpy(seen.sysex, data, MIN(length, sizeof(seen.sysex)));
}

static MidiParser parser;

static void feed(const uint8_t *bytes, size_t len, uint8_t channel)
{
	for (size_t i = 0; i < len; i++) {
		parser.feed(bytes[i], channel);
	}
}

static void reset(void *fixture)
{
	ARG_UNUSED(fixture);

	memset(&seen, 0, sizeof(seen));

	parser = MidiParser();
	parser.set_callbacks(MIDI::Callbacks{.note_on = on_note_on,
					     .note_off = on_note_off,
					     .clock = on_clock,
					     .start = on_start,
					     .cont = on_continue,
					     .stop = on_stop,
					     .cc = on_cc,
					     .sysex = on_sysex});
}

ZTEST_SUITE(midi_parser, NULL, NULL, reset, NULL, NULL);

ZTEST(midi_parser, test_note_on)
{
	const uint8_t msg[] = {0x91, 0x3c, 0x64}; /* channel 2, note 60, vel 100 */

	feed(msg, sizeof(msg), 2);

	zassert_equal(seen.note_on_count, 1, "expected one note on");
	zassert_equal(seen.last_channel, 2, "channel is reported 1-based");
	zassert_equal(seen.last_data1, 0x3c);
	zassert_equal(seen.last_data2, 0x64);
}

ZTEST(midi_parser, test_note_off)
{
	const uint8_t msg[] = {0x80, 0x3c, 0x40};

	feed(msg, sizeof(msg), 1);

	zassert_equal(seen.note_off_count, 1);
	zassert_equal(seen.note_on_count, 0);
	zassert_equal(seen.last_data1, 0x3c);
}

/* A note on with zero velocity is the conventional way to spell note off. */
ZTEST(midi_parser, test_note_on_zero_velocity_is_note_off)
{
	const uint8_t msg[] = {0x90, 0x3c, 0x00};

	feed(msg, sizeof(msg), 1);

	zassert_equal(seen.note_off_count, 1, "zero velocity should report note off");
	zassert_equal(seen.note_on_count, 0);
}

ZTEST(midi_parser, test_running_status)
{
	/* One status byte followed by three note pairs. */
	const uint8_t msg[] = {0x90, 0x3c, 0x40, 0x3e, 0x40, 0x40, 0x40};

	feed(msg, sizeof(msg), 1);

	zassert_equal(seen.note_on_count, 3, "running status should repeat the last status");
	zassert_equal(seen.last_data1, 0x40, "last note should be the third one");
}

ZTEST(midi_parser, test_channel_filtering)
{
	const uint8_t on_ch1[] = {0x90, 0x3c, 0x40};
	const uint8_t on_ch2[] = {0x91, 0x3e, 0x40};

	feed(on_ch1, sizeof(on_ch1), 1);
	feed(on_ch2, sizeof(on_ch2), 1);

	zassert_equal(seen.note_on_count, 1, "messages on other channels must be dropped");
	zassert_equal(seen.last_data1, 0x3c);
}

ZTEST(midi_parser, test_control_change)
{
	const uint8_t msg[] = {0xb0, 74, 99};

	feed(msg, sizeof(msg), 1);

	zassert_equal(seen.cc_count, 1);
	zassert_equal(seen.last_data1, 74);
	zassert_equal(seen.last_data2, 99);
}

ZTEST(midi_parser, test_realtime_messages)
{
	const uint8_t msg[] = {0xf8, 0xfa, 0xfb, 0xfc};

	feed(msg, sizeof(msg), 1);

	zassert_equal(seen.clock_count, 1);
	zassert_equal(seen.start_count, 1);
	zassert_equal(seen.cont_count, 1);
	zassert_equal(seen.stop_count, 1);
}

/* Real time bytes are allowed to arrive between the bytes of another message. */
ZTEST(midi_parser, test_realtime_interleaved_in_voice_message)
{
	const uint8_t msg[] = {0x90, 0x3c, 0xf8, 0x40};

	feed(msg, sizeof(msg), 1);

	zassert_equal(seen.clock_count, 1, "clock should be dispatched immediately");
	zassert_equal(seen.note_on_count, 1, "the note should survive the interruption");
	zassert_equal(seen.last_data2, 0x40);
}

ZTEST(midi_parser, test_sysex_includes_framing)
{
	/* The firmware version request the DUO answers. */
	const uint8_t msg[] = {0xf0, 0x7d, 0x64, 0x01, 0xf7};

	feed(msg, sizeof(msg), 1);

	zassert_equal(seen.sysex_count, 1);
	zassert_equal(seen.sysex_len, sizeof(msg), "0xF0 and 0xF7 are part of the buffer");
	zassert_mem_equal(seen.sysex, msg, sizeof(msg));
}

/* Real time bytes inside a sysex must not end up in the reassembled buffer. */
ZTEST(midi_parser, test_realtime_inside_sysex)
{
	const uint8_t stream[] = {0xf0, 0x7d, 0xf8, 0x64, 0x01, 0xf7};
	const uint8_t expected[] = {0xf0, 0x7d, 0x64, 0x01, 0xf7};

	feed(stream, sizeof(stream), 1);

	zassert_equal(seen.clock_count, 1);
	zassert_equal(seen.sysex_count, 1);
	zassert_equal(seen.sysex_len, sizeof(expected));
	zassert_mem_equal(seen.sysex, expected, sizeof(expected));
}

/* An unterminated sysex is abandoned when the next status byte arrives. */
ZTEST(midi_parser, test_sysex_interrupted_by_status)
{
	const uint8_t stream[] = {0xf0, 0x7d, 0x64, 0x90, 0x3c, 0x40};

	feed(stream, sizeof(stream), 1);

	zassert_equal(seen.sysex_count, 0, "an interrupted sysex must not be dispatched");
	zassert_equal(seen.note_on_count, 1, "the interrupting message should still parse");
}

/* A sysex longer than the reassembly buffer must not overrun it. */
ZTEST(midi_parser, test_sysex_overflow_is_truncated)
{
	parser.feed(0xf0, 1);
	for (unsigned i = 0; i < MidiParser::SYSEX_MAX * 2; i++) {
		parser.feed(0x01, 1);
	}
	parser.feed(0xf7, 1);

	zassert_equal(seen.sysex_count, 1);
	zassert_true(seen.sysex_len <= MidiParser::SYSEX_MAX,
		     "reassembly must stay inside the buffer, got %u", seen.sysex_len);
}

/* Data bytes with no preceding status byte are meaningless and dropped. */
ZTEST(midi_parser, test_data_without_status_is_ignored)
{
	const uint8_t stream[] = {0x3c, 0x40, 0x3e};

	feed(stream, sizeof(stream), 1);

	zassert_equal(seen.note_on_count, 0);
	zassert_equal(seen.note_off_count, 0);
	zassert_equal(seen.cc_count, 0);
}

/* System common cancels running status, per the MIDI specification. */
ZTEST(midi_parser, test_system_common_cancels_running_status)
{
	const uint8_t stream[] = {0x90, 0x3c, 0x40, 0xf3, 0x01, 0x3e, 0x40};

	feed(stream, sizeof(stream), 1);

	zassert_equal(seen.note_on_count, 1, "only the first note should be decoded");
}

/* What the soft thru sends back out, one entry per message. */
static struct {
	unsigned count;
	uint8_t bytes[512];
	size_t len;
	size_t lens[32];
} thru;

static void on_thru(const uint8_t *bytes, size_t len)
{
	zassert_true(thru.len + len <= sizeof(thru.bytes));
	memcpy(&thru.bytes[thru.len], bytes, len);
	thru.len += len;
	if (thru.count < ARRAY_SIZE(thru.lens)) {
		thru.lens[thru.count] = len;
	}
	thru.count++;
}

static void enable_thru(void)
{
	memset(&thru, 0, sizeof(thru));
	parser.set_thru(on_thru);
}

/*
 * Like the Arduino library's Thru::Full, every channel is passed on, not only
 * the one the DUO listens to, and running status is expanded.
 */
ZTEST(midi_parser, test_thru_passes_all_channels_as_whole_messages)
{
	const uint8_t stream[] = {0x95, 0x3c, 0x40, 0x3e, 0x41, 0xb0, 0x07, 0x64};
	const uint8_t expected[] = {0x95, 0x3c, 0x40, 0x95, 0x3e, 0x41, 0xb0, 0x07, 0x64};

	enable_thru();
	feed(stream, sizeof(stream), 1);

	zassert_equal(thru.count, 3);
	zassert_equal(thru.len, sizeof(expected));
	zassert_mem_equal(thru.bytes, expected, sizeof(expected));
	zassert_equal(seen.cc_count, 1, "the DUO still only reacts to its own channel");
	zassert_equal(seen.note_on_count, 0);
}

/* Messages the DUO ignores still go through. */
ZTEST(midi_parser, test_thru_passes_messages_the_duo_ignores)
{
	const uint8_t stream[] = {
		0xc2, 0x05,             /* program change */
		0xe0, 0x00, 0x40,       /* pitch bend */
		0xf2, 0x10, 0x00,       /* song position */
		0xf3, 0x02,             /* song select */
		0xf1, 0x31,             /* MTC quarter frame */
		0xf6,                   /* tune request */
	};

	enable_thru();
	feed(stream, sizeof(stream), 1);

	zassert_equal(thru.count, 6);
	zassert_equal(thru.len, sizeof(stream));
	zassert_mem_equal(thru.bytes, stream, sizeof(stream));
}

/* A real time byte inside a message is echoed on its own, and the message after it intact. */
ZTEST(midi_parser, test_thru_realtime_inside_message)
{
	const uint8_t stream[] = {0x90, 0x3c, 0xf8, 0x40};
	const uint8_t expected[] = {0xf8, 0x90, 0x3c, 0x40};

	enable_thru();
	feed(stream, sizeof(stream), 1);

	zassert_equal(thru.count, 2);
	zassert_equal(thru.lens[0], 1);
	zassert_mem_equal(thru.bytes, expected, sizeof(expected));
	zassert_equal(seen.clock_count, 1);
	zassert_equal(seen.note_on_count, 1);
}

ZTEST(midi_parser, test_thru_sysex)
{
	const uint8_t stream[] = {0xf0, 0x7d, 0x64, 0x01, 0xf7};

	enable_thru();
	feed(stream, sizeof(stream), 1);

	zassert_equal(thru.count, 1);
	zassert_mem_equal(thru.bytes, stream, sizeof(stream));
}

/* A sysex that did not fit is not passed on in pieces. */
ZTEST(midi_parser, test_thru_drops_oversized_sysex)
{
	enable_thru();

	parser.feed(0xf0, 1);
	for (unsigned i = 0; i < MidiParser::SYSEX_MAX; i++) {
		parser.feed(0x01, 1);
	}
	parser.feed(0xf7, 1);

	zassert_equal(thru.count, 0);
}

/* An unterminated sysex is not passed on either. */
ZTEST(midi_parser, test_thru_drops_interrupted_sysex)
{
	const uint8_t stream[] = {0xf0, 0x7d, 0x64, 0x90, 0x3c, 0x40};
	const uint8_t expected[] = {0x90, 0x3c, 0x40};

	enable_thru();
	feed(stream, sizeof(stream), 1);

	zassert_equal(thru.count, 1);
	zassert_mem_equal(thru.bytes, expected, sizeof(expected));
}

/* Without a handler nothing changes, which is how the USB side runs. */
ZTEST(midi_parser, test_no_thru_by_default)
{
	const uint8_t stream[] = {0x90, 0x3c, 0x40};

	memset(&thru, 0, sizeof(thru));
	feed(stream, sizeof(stream), 1);

	zassert_equal(thru.count, 0);
	zassert_equal(seen.note_on_count, 1);
}
```

## src/test_ump_convert.cpp
```c
/*
 * Copyright (c) 2025 Dato Musical Instruments
 * SPDX-License-Identifier: Apache-2.0
 *
 * Tests for the translation between MIDI 1.0 byte streams and Universal MIDI
 * Packets. The DUO speaks MIDI 1.0 internally and only meets UMP at the USB
 * boundary, so anything that survives a round trip through this layer behaves
 * identically on both transports.
 */

#include "platform/ump_convert.h"

#include <zephyr/ztest.h>

#include <cstring>

#define MAX_PACKETS 8

struct capture {
	size_t count;
	struct midi_ump packets[MAX_PACKETS];
};

static void collect(const struct midi_ump &packet, void *user_data)
{
	struct capture *c = (struct capture *)user_data;

	if (c->count < MAX_PACKETS) {
		c->packets[c->count] = packet;
	}

	c->count++;
}

static struct capture encode(const uint8_t *bytes, size_t len)
{
	struct capture c = {};

	ump::from_midi1(bytes, len, collect, &c);
	return c;
}

/* Feeds a MIDI 1.0 message through UMP and back, returning what came out. */
static size_t round_trip(const uint8_t *in, size_t in_len, uint8_t *out, size_t out_len)
{
	struct capture c = encode(in, in_len);
	ump::RxState state = {};
	size_t total = 0;

	for (size_t i = 0; i < c.count && i < MAX_PACKETS; i++) {
		uint8_t chunk[ump::MAX_MIDI1_BYTES];
		const size_t len = ump::to_midi1(c.packets[i], state, chunk, sizeof(chunk));

		for (size_t j = 0; j < len && total < out_len; j++) {
			out[total++] = chunk[j];
		}
	}

	return total;
}

ZTEST_SUITE(ump_convert, NULL, NULL, NULL, NULL, NULL);

ZTEST(ump_convert, test_note_on_encodes_to_one_packet)
{
	const uint8_t msg[] = {0x91, 0x3c, 0x64};
	struct capture c = encode(msg, sizeof(msg));

	zassert_equal(c.count, 1, "a channel voice message is one packet");
	zassert_equal(UMP_MT(c.packets[0]), UMP_MT_MIDI1_CHANNEL_VOICE);
	zassert_equal(UMP_MIDI_COMMAND(c.packets[0]), UMP_MIDI_NOTE_ON);
	zassert_equal(UMP_MIDI_CHANNEL(c.packets[0]), 1, "channel is zero-based on the wire");
	zassert_equal(UMP_MIDI1_P1(c.packets[0]), 0x3c);
	zassert_equal(UMP_MIDI1_P2(c.packets[0]), 0x64);
}

ZTEST(ump_convert, test_realtime_encodes_to_system_packet)
{
	const uint8_t msg[] = {0xf8};
	struct capture c = encode(msg, sizeof(msg));

	zassert_equal(c.count, 1);
	zassert_equal(UMP_MT(c.packets[0]), UMP_MT_SYS_RT_COMMON);
	zassert_equal(UMP_MIDI_STATUS(c.packets[0]), 0xf8);
}

ZTEST(ump_convert, test_short_sysex_is_a_single_packet)
{
	/* Four payload bytes fit in one Data64 packet. */
	const uint8_t msg[] = {0xf0, 0x7d, 0x64, 0x01, 0x02, 0xf7};
	struct capture c = encode(msg, sizeof(msg));

	zassert_equal(c.count, 1, "four payload bytes fit one packet");
	zassert_equal(UMP_MT(c.packets[0]), UMP_MT_DATA_64);
	zassert_equal((c.packets[0].data[0] >> 20) & 0x0f, 0x0, "status should be 'complete'");
	zassert_equal((c.packets[0].data[0] >> 16) & 0x0f, 4, "four payload bytes");
}

ZTEST(ump_convert, test_long_sysex_is_split_across_packets)
{
	/* 14 payload bytes: start (6), continue (6), end (2). */
	uint8_t msg[16];

	msg[0] = 0xf0;
	for (int i = 0; i < 14; i++) {
		msg[1 + i] = i;
	}
	msg[15] = 0xf7;

	struct capture c = encode(msg, sizeof(msg));

	zassert_equal(c.count, 3, "14 payload bytes need three packets");
	zassert_equal((c.packets[0].data[0] >> 20) & 0x0f, 0x1, "first packet is 'start'");
	zassert_equal((c.packets[1].data[0] >> 20) & 0x0f, 0x2, "middle packet is 'continue'");
	zassert_equal((c.packets[2].data[0] >> 20) & 0x0f, 0x3, "last packet is 'end'");
	zassert_equal((c.packets[2].data[0] >> 16) & 0x0f, 2, "two bytes left over");
}

ZTEST(ump_convert, test_round_trip_note_on)
{
	const uint8_t msg[] = {0x91, 0x3c, 0x64};
	uint8_t out[8];

	const size_t len = round_trip(msg, sizeof(msg), out, sizeof(out));

	zassert_equal(len, sizeof(msg));
	zassert_mem_equal(out, msg, sizeof(msg));
}

ZTEST(ump_convert, test_round_trip_program_change_is_two_bytes)
{
	/* Program change carries one parameter, not two. */
	const uint8_t msg[] = {0xc0, 0x07};
	uint8_t out[8];

	const size_t len = round_trip(msg, sizeof(msg), out, sizeof(out));

	zassert_equal(len, 2, "program change must not gain a third byte");
	zassert_mem_equal(out, msg, sizeof(msg));
}

ZTEST(ump_convert, test_round_trip_realtime)
{
	const uint8_t msg[] = {0xfa};
	uint8_t out[8];

	const size_t len = round_trip(msg, sizeof(msg), out, sizeof(out));

	zassert_equal(len, 1);
	zassert_equal(out[0], 0xfa);
}

ZTEST(ump_convert, test_round_trip_short_sysex)
{
	const uint8_t msg[] = {0xf0, 0x7d, 0x64, 0x01, 0xf7};
	uint8_t out[16];

	const size_t len = round_trip(msg, sizeof(msg), out, sizeof(out));

	zassert_equal(len, sizeof(msg));
	zassert_mem_equal(out, msg, sizeof(msg));
}

/* The serial number reply is 24 bytes, the longest sysex the DUO sends. */
ZTEST(ump_convert, test_round_trip_long_sysex)
{
	uint8_t msg[24];
	uint8_t out[32];

	msg[0] = 0xf0;
	for (int i = 1; i < 23; i++) {
		msg[i] = i & 0x7f;
	}
	msg[23] = 0xf7;

	const size_t len = round_trip(msg, sizeof(msg), out, sizeof(out));

	zassert_equal(len, sizeof(msg), "round trip changed the length");
	zassert_mem_equal(out, msg, sizeof(msg), "round trip changed the payload");
}

/*
 * A receiver that starts listening mid-transfer would otherwise inject bare
 * data bytes into the stream, which the parser would attribute to whatever
 * running status was latched.
 */
ZTEST(ump_convert, test_sysex_continuation_without_start_is_dropped)
{
	struct midi_ump packet = {};
	ump::RxState state = {};
	uint8_t out[ump::MAX_MIDI1_BYTES];

	/* A 'continue' packet carrying six bytes, with no preceding 'start'. */
	packet.data[0] = ((uint32_t)UMP_MT_DATA_64 << 28) | (0x2u << 20) | (6u << 16);
	packet.data[1] = 0;

	const size_t len = ump::to_midi1(packet, state, out, sizeof(out));

	zassert_equal(len, 0, "continuation without a start must produce nothing");
}

ZTEST(ump_convert, test_unknown_packet_type_is_ignored)
{
	struct midi_ump packet = {};
	ump::RxState state = {};
	uint8_t out[ump::MAX_MIDI1_BYTES];

	/* Message type 5 is a 128-bit data message the DUO does not use. */
	packet.data[0] = 0x5u << 28;

	zassert_equal(ump::to_midi1(packet, state, out, sizeof(out)), 0);
}

ZTEST(ump_convert, test_stray_data_byte_produces_nothing)
{
	const uint8_t msg[] = {0x3c};

	zassert_equal(encode(msg, sizeof(msg)).count, 0);
	zassert_equal(encode(NULL, 0).count, 0);
}
```
