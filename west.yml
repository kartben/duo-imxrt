## zephyr/boards/dato/duo_brains2/Kconfig.duo_brains2
```kconfig
# Copyright (c) 2025 Dato Musical Instruments
# SPDX-License-Identifier: Apache-2.0

config BOARD_DUO_BRAINS2
	select SOC_PART_NUMBER_MIMXRT1011DAE5A
```

## zephyr/dts/bindings/led_strip/dato,ws2812-flexio-imxrt.yaml
```yaml
# Copyright (c) 2025 Dato Musical Instruments
# SPDX-License-Identifier: Apache-2.0

description: |
  WS2812 / SK6812 LED strip driven by an i.MX RT FlexIO peripheral.

  FlexIO generates the WS2812 line code entirely in hardware: one shifter
  streams the (pre-expanded) pixel bits, and four timers turn each bit into a
  "0 code" or "1 code" pulse and enforce the reset/latch gap. Pixel data is
  pushed into the shifter by eDMA, so a strip update costs no CPU time.

  The FlexIO pin index is the FlexIO peripheral's own pin number (FLEXIO1_IOxx),
  not a GPIO number, and the pad must be muxed to that FlexIO function through
  the referenced pinctrl state.

compatible: "dato,ws2812-flexio-imxrt"

include: [ws2812.yaml, base.yaml, pinctrl-device.yaml]

properties:
  reg:
    required: true

  flexio-pin:
    type: int
    required: true
    description: |
      FlexIO pin index (FLEXIO1_IOxx) that carries the LED data line.

  dmas:
    required: true

  dma-names:
    required: true

  clock-pre-div:
    type: int
    default: 5
    description: |
      FlexIO root clock pre-divider (actual divide-by value, 1..8). Together
      with clock-div this must yield a 16 MHz FlexIO clock, which is what the
      hard-coded WS2812 bit timings below assume.

  clock-div:
    type: int
    default: 6
    description: |
      FlexIO root clock post-divider (actual divide-by value, 1..8).

  reset-delay-bits:
    type: int
    default: 240
    description: |
      Length of the trailing reset/latch gap, in WS2812 bit periods. Newer
      WS2812 revisions need at least 300 us; at 1.25 us per bit the default of
      240 gives 300 us.
```

## zephyr/dts/bindings/misc/dato,duo-analog-mux.yaml
```yaml
# Copyright (c) 2025 Dato Musical Instruments
# SPDX-License-Identifier: Apache-2.0

description: |
  Analog front end of the Dato DUO control panel.

  Every potentiometer, slide switch and drum pad on the DUO is read through
  8:1 analog multiplexers. Three multiplexers share one set of address lines
  and each has its own I/O pad wired to an ADC input:

    "syn"  - synth pots (filter res, amp, cutoff, detune, PW, env) plus the
             GLIDE and DELAY switches
    "syn2" - ACCENT and BITCRUSH switches and the six drum pad segments
    "brn"  - tempo/gate pots, headphone-jack detect and sync-in detect

  Channels that are logically digital are sampled with the ADC and compared
  against a threshold, which is electrically equivalent to a high-impedance
  digital input. The two channels that need a pull-up (GLIDE and DELAY) are
  handled by re-muxing the "syn" pad to GPIO, which is why both a pinctrl
  state and a GPIO specifier are given for it.

compatible: "dato,duo-analog-mux"

include: [base.yaml, pinctrl-device.yaml]

properties:
  addr-gpios:
    type: phandle-array
    required: true
    description: |
      The three multiplexer address lines, least significant first.

  io-channels:
    type: phandle-array
    required: true
    description: ADC channel for each multiplexer I/O pad.

  io-channel-names:
    type: string-array
    required: true
    description: Names matching io-channels, expected to be "syn", "syn2", "brn".

  syn-gpios:
    type: phandle-array
    required: true
    description: |
      The "syn" multiplexer I/O pad expressed as a GPIO, used for the pulled-up
      switch channels. Requires a "syn-gpio" pinctrl state that muxes the pad
      away from the ADC and enables its pull-up.

  settle-time-us:
    type: int
    default: 50
    description: |
      Delay between changing the address lines and sampling, to let the
      multiplexer output and the RC filtering on the pot wipers settle.
```

## zephyr/dts/bindings/misc/dato,duo-audio-path.yaml
```yaml
# Copyright (c) 2025 Dato Musical Instruments
# SPDX-License-Identifier: Apache-2.0

description: |
  Output stage of the Dato DUO audio path: the built-in speaker amplifier and
  the headphone driver, each with its own enable line. Exactly one of the two
  is active at a time, selected by the headphone-jack detect channel on the
  "brn" multiplexer.

compatible: "dato,duo-audio-path"

include: [base.yaml, pinctrl-device.yaml]

properties:
  headphone-enable-gpios:
    type: phandle-array
    required: true
    description: Drives the headphone amplifier enable pin.

  amp-mute-gpios:
    type: phandle-array
    required: true
    description: |
      Drives the speaker amplifier shutdown pin. Asserting this signal mutes
      the speaker; the line is released to a high-impedance input while muted
      so the amplifier's own pull-up holds it.

      With mute-level-strap the flags' polarity is not used: the level that
      mutes the amplifier is read from the board at start-up instead.

  mute-level-strap:
    type: boolean
    description: |
      The shutdown line is pulled to the amplifier's mute level by a resistor
      on the board, because the amplifier fitted - and with it the level that
      mutes it - varies. The firmware releases the line with the pad's
      pull/keeper disabled (the "default" pinctrl state), reads the strap, and
      from then on drives that level to mute and the opposite one to enable.
```

## zephyr/dts/bindings/misc/dato,duo-sync.yaml
```yaml
# Copyright (c) 2025 Dato Musical Instruments
# SPDX-License-Identifier: Apache-2.0

description: |
  Analog clock sync jacks (Korg Volca / Pocket Operator style). A pulse on the
  input jack advances the sequencer clock; the output jack emits one pulse per
  sequencer step. Presence of a cable on the input jack is detected through the
  "brn" multiplexer rather than through this node.

compatible: "dato,duo-sync"

include: base.yaml

properties:
  in-gpios:
    type: phandle-array
    required: true
    description: Sync input jack, edge-triggered.

  out-gpios:
    type: phandle-array
    required: true
    description: Sync output jack.
```
